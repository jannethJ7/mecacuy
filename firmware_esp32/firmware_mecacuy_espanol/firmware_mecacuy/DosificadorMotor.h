#pragma once
#include <Arduino.h>
#include <esp_arduino_version.h>
#include <esp_timer.h>
#include <freertos/FreeRTOS.h>
#include <freertos/semphr.h>

#if ESP_ARDUINO_VERSION_MAJOR < 3
#error "DosificadorMotor requiere Arduino-ESP32 3.x"
#endif

// STEP is generated by LEDC hardware. The timer task only checks the deadline;
// it does not perform HTTP, logging, sensor reads or command acknowledgements.
namespace DosificadorMotor {
static SemaphoreHandle_t mutex = nullptr;
static esp_timer_handle_t temporizador = nullptr;
static int paso = -1;
static int habilitacion = -1;
static int nivelDeshabilitado = LOW;
static int64_t limiteUs = 0;
static bool agotado = false;

static void apagarBloqueado() {
  if (paso >= 0) {
    ledcWrite(paso, 0);
    ledcDetach(paso);
    pinMode(paso, OUTPUT);
    digitalWrite(paso, LOW);
  }
  if (habilitacion >= 0) digitalWrite(habilitacion, nivelDeshabilitado);
  paso = -1;
  habilitacion = -1;
  limiteUs = 0;
}

static void comprobarLimite(void*) {
  if (xSemaphoreTake(mutex, 0) != pdTRUE) return;
  if (paso >= 0 && limiteUs > 0 && esp_timer_get_time() >= limiteUs) {
    apagarBloqueado();
    agotado = true;
  }
  xSemaphoreGive(mutex);
}

static bool preparar() {
  if (!mutex) mutex = xSemaphoreCreateMutex();
  if (!mutex) return false;
  if (temporizador) return true;
  esp_timer_create_args_t args = {};
  args.callback = comprobarLimite;
  args.dispatch_method = ESP_TIMER_TASK;
  args.name = "fin_dosificador";
  args.skip_unhandled_events = true;
  if (esp_timer_create(&args, &temporizador) != ESP_OK) return false;
  if (esp_timer_start_periodic(temporizador, 5000) != ESP_OK) {
    esp_timer_delete(temporizador);
    temporizador = nullptr;
    return false;
  }
  return true;
}

static bool iniciar(int pinPaso, int pinEn, int enApagado,
                    uint32_t semiperiodoUs, uint32_t duracionSeg, bool temporizado) {
  if (pinPaso < 0 || pinPaso > 33 || pinPaso == pinEn || semiperiodoUs < 2) return false;
  // Setup creates the shared resources before MQTT can deliver commands.
  if (!mutex || !temporizador) return false;
  xSemaphoreTake(mutex, portMAX_DELAY);
  apagarBloqueado();
  agotado = false;
  // Arduino's LEDC API accepts integer Hz: 3000 us half-period becomes 167 Hz.
  const uint32_t frecuencia = (500000UL + semiperiodoUs / 2) / semiperiodoUs;
  if (!frecuencia || !ledcAttach(pinPaso, frecuencia, 8)) {
    pinMode(pinPaso, OUTPUT);
    digitalWrite(pinPaso, LOW);
    xSemaphoreGive(mutex);
    return false;
  }
  paso = pinPaso;
  habilitacion = pinEn;
  nivelDeshabilitado = enApagado;
  if (!ledcWrite(paso, 128)) {
    apagarBloqueado();
    xSemaphoreGive(mutex);
    return false;
  }
  limiteUs = temporizado ? esp_timer_get_time() + (int64_t)duracionSeg * 1000000LL : 0;
  xSemaphoreGive(mutex);
  return true;
}

static void detener() {
  if (!mutex) return;
  xSemaphoreTake(mutex, portMAX_DELAY);
  apagarBloqueado();
  agotado = false;
  xSemaphoreGive(mutex);
}

static bool vencido() {
  if (!mutex) return false;
  xSemaphoreTake(mutex, portMAX_DELAY);
  bool resultado = agotado;
  xSemaphoreGive(mutex);
  return resultado;
}

static bool ocupaPin(int gpio) {
  if (!mutex) return false;
  xSemaphoreTake(mutex, portMAX_DELAY);
  bool resultado = paso >= 0 && (gpio == paso || gpio == habilitacion);
  xSemaphoreGive(mutex);
  return resultado;
}
}
